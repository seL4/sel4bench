## apps/aes/Kconfig
```kconfig
#
# Copyright 2014, NICTA
#
# This software may be distributed and modified according to the terms of
# the BSD 2-Clause license. Note that NO WARRANTY is provided.
# See "LICENSE_BSD2.txt" for details.
#
# @TAG(NICTA_BSD)
#

config APP_AES
    bool "Aes server"
    depends on APP_SEL4BENCH
    default y
    depends on LIB_SEL4 && HAVE_LIBC && LIB_SEL4_ALLOCMAN && LIB_UTILS && LIB_SEL4_UTILS && \
    LIB_SEL4_BENCH && LIB_ELF && LIB_SEL4_SIMPLE && LIB_SEL4_VKA && \
    LIB_SEL4_PLAT_SUPPORT && LIB_PLATSUPPORT && LIB_SEL4_BENCHSUPPORT \
    && LIB_SEL4_MUSLC_SYS
    depends on DANGEROUS_CODE_INJECTION || EXPORT_PMU_USER
    help
        Application to benchmark seL4 aess without modification to the kernel.
```

## apps/fault/Kconfig
```kconfig
#
# Copyright 2017, Data61
# Commonwealth Scientific and Industrial Research Organisation (CSIRO)
# ABN 41 687 119 230.
#
# This software may be distributed and modified according to the terms of
# the BSD 2-Clause license. Note that NO WARRANTY is provided.
# See "LICENSE_BSD2.txt" for details.
#
# @TAG(DATA61_BSD)
#

config APP_FAULTBENCH
    bool "Fault handler benchmarks"
    depends on APP_SEL4BENCH
    # the fault benchmark triggers an undefined instruction, which does not work on
    # armv6 as undefined instruction is leveraged to read the cycle count efficiently
    # when benchmarking seL4. This only occurs when CONFIG_DANGEROUS_CODE_INJECTION
    # is enabled, however this option is enabled by sel4bench in order to read the cycle
    # counter.
    depends on !ARCH_ARM_V6
    default y
    depends on LIB_SEL4 && HAVE_LIBC && LIB_SEL4_ALLOCMAN && LIB_UTILS && LIB_SEL4_UTILS && \
    LIB_SEL4_BENCH && LIB_ELF && LIB_SEL4_SIMPLE && LIB_SEL4_VKA && \
    LIB_SEL4_PLAT_SUPPORT && LIB_PLATSUPPORT && LIB_SEL4_BENCHSUPPORT \
    && LIB_SEL4_MUSLC_SYS
    depends on DANGEROUS_CODE_INJECTION || EXPORT_PMU_USER
    help
        Application to benchmark seL4 faults without modification to the kernel.
```

## apps/ipc/Kconfig
```kconfig
#
# Copyright 2017, Data61
# Commonwealth Scientific and Industrial Research Organisation (CSIRO)
# ABN 41 687 119 230.
#
# This software may be distributed and modified according to the terms of
# the BSD 2-Clause license. Note that NO WARRANTY is provided.
# See "LICENSE_BSD2.txt" for details.
#
# @TAG(DATA61_BSD)
#

menuconfig APP_IPCBENCH
    bool "IPC benchmarks"
    depends on APP_SEL4BENCH
    default y
    depends on LIB_SEL4 && HAVE_LIBC && LIB_SEL4_ALLOCMAN && LIB_UTILS && LIB_SEL4_UTILS && \
    LIB_SEL4_BENCH && LIB_ELF && LIB_SEL4_SIMPLE && LIB_CPIO && LIB_SEL4_VKA && LIB_SEL4_VSPACE && \
    LIB_SEL4_MUSLC_SYS && LIB_SEL4_SIMPLE && LIB_SEL4_BENCHSUPPORT
    depends on (ARCH_X86 && EXPORT_PMC_USER && KERNEL_X86_DANGEROUS_MSR) || \
        (ARCH_ARM && EXPORT_PMU_USER) || \
        (ARCH_ARM_V6 && DANGEROUS_CODE_INJECTION) || \
        (ARM_CORTEX_A8 && DANGEROUS_CODE_INJECTION)
    help
        Application to benchmark seL4 IPC.

    choice
        depends on APP_IPCBENCH
        prompt "Counter to measure"
        default CYCLE_COUNT

        config CYCLE_COUNT
            bool "Cycle count"
        config GENERIC_COUNTER
            bool "Generic counter"
    endchoice

    config GENERIC_COUNTER_ID
        depends on APP_IPCBENCH
        depends on GENERIC_COUNTER
        range 0 6
        default 0
        int "Generic counter id"
        help
            Select the generic counter to measure in the ipc benchmarks
                0 - CACHE_L1I_MISS
                1 - CACHE_L1D_MISS
                2 - TLB_L1I_MISS
                3 - TLB_L1D_MISS
                4 - EXECUTE_INSTRUCTION
                5 - BRANCH_MISPREDICT
                6 - MEMORY_ACCESS
                bool "memory access"
```

## apps/irq/Kconfig
```kconfig
#
# Copyright 2017, Data61
# Commonwealth Scientific and Industrial Research Organisation (CSIRO)
# ABN 41 687 119 230.
#
# This software may be distributed and modified according to the terms of
# the BSD 2-Clause license. Note that NO WARRANTY is provided.
# See "LICENSE_BSD2.txt" for details.
#
# @TAG(DATA61_BSD)
#

config APP_IRQBENCH
    bool "IRQ benchmarks"
    depends on APP_SEL4BENCH
    default n
    depends on LIB_SEL4 && HAVE_LIBC && LIB_SEL4_ALLOCMAN && LIB_UTILS && LIB_SEL4_UTILS && \
    LIB_SEL4_BENCH && LIB_ELF && LIB_SEL4_SIMPLE && LIB_SEL4_VKA && LIB_SEL4_MUSLC_SYS && \
    LIB_SEL4_PLAT_SUPPORT && LIB_PLATSUPPORT && LIB_SEL4_BENCHSUPPORT
    depends on DANGEROUS_CODE_INJECTION || EXPORT_PMU_USER
    help
        Application to benchmark seL4 IRQs from inside the kernel. 
        Requires tracepoints (see irq-tracepoint branch or kernel.
```

## apps/sel4bench/Kconfig
```kconfig
#
# Copyright 2017, Data61
# Commonwealth Scientific and Industrial Research Organisation (CSIRO)
# ABN 41 687 119 230.
#
# This software may be distributed and modified according to the terms of
# the BSD 2-Clause license. Note that NO WARRANTY is provided.
# See "LICENSE_BSD2.txt" for details.
#
# @TAG(DATA61_GPL)
#

config APP_SEL4BENCH
    bool "seL4bench"
    default y
    depends on LIB_SEL4_ALLOCMAN && LIB_SEL4 && HAVE_LIBC && LIB_UTILS && LIB_SEL4_UTILS && LIB_SEL4_PLAT_SUPPORT && LIB_SEL4_BENCH && LIB_PLATSUPPORT && LIB_SEL4_DEBUG && LIB_SEL4_BENCHSUPPORT && LIB_JANSSON
    help
        seL4 Benchmark application.

menu "seL4bench settings"

config ALLOW_UNSTABLE_OVERHEAD
    depends on APP_SEL4BENCH
    bool "Allow unstable overhead"
    default n
    help
        Do not fail when stable values are not stable.

config OUTPUT_RAW_RESULTS
    depends on APP_SEL4BENCH
    bool "Output raw results"
    default y
    help
        As well as outputting statistics, dump raw results in JSON format.

config JSON_INDENT
    depends on APP_SEL4BENCH
    int "JSON indent"
    default 0
    range 0 31
    help
        Set the indent for JSON. By default it is 0, which is very fast to output,
        however setting the indent higher allows for more human readable output.

endmenu
```

## apps/signal/Kconfig
```kconfig
#
# Copyright 2017, Data61
# Commonwealth Scientific and Industrial Research Organisation (CSIRO)
# ABN 41 687 119 230.
#
# This software may be distributed and modified according to the terms of
# the BSD 2-Clause license. Note that NO WARRANTY is provided.
# See "LICENSE_BSD2.txt" for details.
#
# @TAG(DATA61_BSD)
#

config APP_SIGNALBENCH
    bool "Signal benchmarks"
    depends on APP_SEL4BENCH
    default y
    depends on LIB_SEL4 && HAVE_LIBC && LIB_SEL4_ALLOCMAN && LIB_UTILS && LIB_SEL4_UTILS && \
    LIB_SEL4_BENCH && LIB_ELF && LIB_SEL4_SIMPLE && LIB_SEL4_VKA && \
    LIB_SEL4_PLAT_SUPPORT && LIB_PLATSUPPORT && LIB_SEL4_BENCHSUPPORT \
    && LIB_SEL4_MUSLC_SYS
    depends on (ARCH_X86 && EXPORT_PMC_USER && KERNEL_X86_DANGEROUS_MSR) || \
        (ARCH_ARM && EXPORT_PMU_USER) || \
        (ARCH_ARM_V6 && DANGEROUS_CODE_INJECTION) || \
        (ARM_CORTEX_A8 && DANGEROUS_CODE_INJECTION)
    help
        Application to benchmark seL4 signals without modification to the kernel.
```

## apps/smp/Kconfig
```kconfig
#
#  Copyright 2017, Data61
#  Commonwealth Scientific and Industrial Research Organisation (CSIRO)
#  ABN 41 687 119 230.
#
#  This software may be distributed and modified according to the terms of
#  the BSD 2-Clause license. Note that NO WARRANTY is provided.
#  See "LICENSE_BSD2.txt" for details.
#
#  @TAG(DATA61_BSD)
#

config APP_SMPBENCH
    bool "SMP benchmarks"
    depends on APP_SEL4BENCH
    default n
    depends on LIB_SEL4 && HAVE_LIBC && LIB_SEL4_ALLOCMAN && LIB_UTILS && LIB_SEL4_UTILS && \
    LIB_SEL4_BENCH && LIB_ELF && LIB_SEL4_SIMPLE && LIB_CPIO && LIB_SEL4_VKA && LIB_SEL4_VSPACE && \
    LIB_SEL4_MUSLC_SYS && LIB_SEL4_SIMPLE && LIB_SEL4_BENCHSUPPORT
    depends on (ARCH_X86 && EXPORT_PMC_USER && DANGEROUS_CODE_INJECTION) || \
        (ARCH_ARM && EXPORT_PMU_USER) || \
        (ARCH_ARM_V6 && DANGEROUS_CODE_INJECTION) || \
        (ARM_CORTEX_A8 && DANGEROUS_CODE_INJECTION)
    depends on MAX_NUM_NODES != 1
    help
        Application to benchmark seL4 multicore kernel.
```

## apps/ulscheduler/Kconfig
```kconfig
#
# Copyright 2014, NICTA
#
# This software may be distributed and modified according to the terms of
# the BSD 2-Clause license. Note that NO WARRANTY is provided.
# See "LICENSE_BSD2.txt" for details.
#
# @TAG(NICTA_BSD)
#

menuconfig APP_ULSCHEDULERBENCH
    bool "Ulscheduler benchmarks"
    depends on APP_SEL4BENCH
    default n
    select FLOG
    depends on LIB_SEL4 && HAVE_LIBC && LIB_SEL4_ALLOCMAN && LIB_UTILS && LIB_SEL4_UTILS && \
    LIB_SEL4_BENCH && LIB_ELF && LIB_SEL4_SIMPLE && LIB_SEL4_VKA && \
    LIB_SEL4_PLAT_SUPPORT && LIB_PLATSUPPORT && LIB_SEL4_BENCHSUPPORT \
    && LIB_SEL4_MUSLC_SYS
    depends on DANGEROUS_CODE_INJECTION || EXPORT_PMU_USER
    help
        Application to benchmark seL4 ulscheduler without modification to the kernel.

    
    config MIN_TASKS
        depends on APP_ULSCHEDULERBENCH
        int "Minimum number of tasks to benchmark"
        default 1

    config NUM_TASK_SETS
        depends on APP_ULSCHEDULERBENCH
        int "Number of tasks sets to benchmark (MAX - MIN)"
        default 10

    config NUM_RUNS
        depends on APP_ULSCHEDULERBENCH
        int "Number scheduling decisions to benchmark"
        default 100 
        
```

## libsel4benchsupport/Kconfig
```kconfig
#
# Copyright 2016, NICTA
#
# This software may be distributed and modified according to the terms of
# the BSD 2-Clause license. Note that NO WARRANTY is provided.
# See "LICENSE_BSD2.txt" for details.
#
# @TAG(NICTA_BSD)
#

menuconfig LIB_SEL4_BENCHSUPPORT
    bool "libsel4benchsupport"
    depends on HAVE_LIB_SEL4 && HAVE_LIBC && HAVE_LIB_UTILS && HAVE_LIB_SEL4_VKA \
    && HAVE_LIB_SEL4_VSPACE && HAVE_LIB_SEL4_ALLOCMAN
    default y
    help
        Support library for sel4bench apps.

config HAVE_LIB_SEL4_BENCHSUPPORT
    bool
```
